## arch/mips/xburst/soc-m200/Kconfig
```kconfig
choice
	prompt "Chip type"
	depends on SOC_M200
	default CHIP_M200

config CHIP_M200
       bool "chip-m200"
       select TRACEPOINTS
       select SYS_SUPPORTS_HIGHMEM
       select GENERIC_CLOCKEVENTS_BROADCAST

endchoice

if CHIP_M200
source "arch/mips/xburst/soc-m200/chip-m200/Kconfig"
endif
```

## arch/mips/xburst/soc-m200/chip-m200/Kconfig
```kconfig
choice
	prompt "Board type"
	depends on CHIP_M200
	default PRODUCT_DEVELOP

config BOARD_4785_FPGA
       bool "FPGA"

config PRODUCT_DEVELOP
       bool "DEVELOP"

config BOARD_NEWTON
       bool "NEWTON"

config BOARD_WATCH
       bool "watch"

endchoice

config PRODUCT_NAME
	string
	default "fpga" if BOARD_4785_FPGA
	default "dorado" if PRODUCT_DEVELOP
	default "newton" if BOARD_NEWTON
	default "watch" if BOARD_WATCH

if PRODUCT_DEVELOP
source "arch/mips/xburst/soc-m200/chip-m200/dorado/Kconfig"
endif

if BOARD_NEWTON
source "arch/mips/xburst/soc-m200/chip-m200/newton/Kconfig"
endif

if BOARD_WATCH
source "arch/mips/xburst/soc-m200/chip-m200/watch/Kconfig"
endif
```

## arch/mips/xburst/soc-m200/chip-m200/newton/Kconfig
```kconfig
choice
	prompt "BOARD type"
	depends on BOARD_NEWTON
	default BOARD_NEWTON2_PLUS


config BOARD_NEWTON_V20
       bool "board newton v20"
       depends on BOARD_NEWTON

config BOARD_NEWTON2_PLUS
       bool "board newton2 plus"
       depends on BOARD_NEWTON

endchoice

config BOARD_NAME
	string
	default "newton2_plus" if BOARD_NEWTON2_PLUS
```

## arch/mips/xburst/soc-m200/chip-m200/watch/Kconfig
```kconfig
choice
	prompt "BOARD type"
	depends on BOARD_WATCH
	default WATCH_AW808

config WATCH_AW808
       bool "watch aw808"
       depends on BOARD_WATCH
endchoice

if WATCH_AW808
source "arch/mips/xburst/soc-m200/chip-m200/watch/aw808/Kconfig"
endif

config BOARD_NAME
	string "BOARD_NAME"
	default "aw808" if WATCH_AW808

config ROOTLIST
	bool "Export hardware information to proc/hardware/list"
    default y
	help
      Export hardware information to proc/hardware/list,
      When boot on Android then read this file and configure system

config BLUETOOTH_NAME
	string  "export bluetooth chip name"
    depends on ROOTLIST
    help
      Export bluetooth chip name information to proc/hardware/list,
      format : bluetooth:chip:bcm20710
```

## arch/mips/xburst/soc-m200/chip-m200/watch/aw808/Kconfig
```kconfig
choice
	prompt "Select hardware version"
	depends on WATCH_AW808
	default AW808_HW_MAIN

config AW808_HW_MAIN
       bool "aw808 hardware version main"
       depends on WATCH_AW808

config AW808_HW_X3
       bool "aw808 hardware version x3"
       depends on WATCH_AW808

config AW808_HW_IN901
       bool "aw808 hardware version in901"
       depends on WATCH_AW808

config AW808_HW_V11_NATURAL_ROUND
       bool "aw808 hardware version v11 for natural round"
       depends on WATCH_AW808

config AW808_HW_V11_WISE_SQUARE
       bool "aw808 hardware version v11 for wise square"
       depends on WATCH_AW808

endchoice
```

## arch/mips/xburst/soc-x1000/Kconfig
```kconfig
choice
	prompt "Chip type"
	depends on SOC_X1000
	default CHIP_X1000

config CHIP_X1000
       bool "chip-x1000"
       select TRACEPOINTS
       select SYS_SUPPORTS_HIGHMEM
       select GENERIC_CLOCKEVENTS_BROADCAST
       select JZ_GPIO_SAVE

endchoice

choice
	prompt "board timer select sys-ost or tcu"
	depends on CHIP_X1000
	default TIMER_SYS_OST
config TIMER_SYS_OST
	bool "sys-ost"
config TIMER_TCU
	bool "tcu"
endchoice

config JZ_GPIO_SAVE
	bool

if CHIP_X1000
source "arch/mips/xburst/soc-x1000/chip-x1000/Kconfig"
endif
```

## arch/mips/xburst/soc-x1000/chip-x1000/Kconfig
```kconfig
choice
	prompt "Board type"
	depends on SOC_X1000
	default PRODUCT_X1000_PHOENIX

config  PRODUCT_X1000_PHOENIX
    bool "product x1000 phoenix"

config	PRODUCT_X1000_HALLEY2
	bool "product x1000 halley2"

endchoice

if PRODUCT_X1000_PHOENIX
config PRODUCT_NAME
string
default "phoenix"
source "arch/mips/xburst/soc-x1000/chip-x1000/phoenix/Kconfig"
endif

if PRODUCT_X1000_HALLEY2
config PRODUCT_NAME
string
default "halley2"
source "arch/mips/xburst/soc-x1000/chip-x1000/halley2/Kconfig"
endif
```

## arch/mips/xburst/soc-x1000/chip-x1000/halley2/Kconfig
```kconfig
choice
prompt "Core Board Version"
depends on PRODUCT_X1000_HALLEY2
default HALLEY2_CORE_V10

config HALLEY2_CORE_V10
bool "halley2 core board v10"

config HALLEY2_MINI_CORE_V10
bool "halley2 mini core board v10"

endchoice


choice
prompt "Ext BOARD version"
depends on PRODUCT_X1000_HALLEY2
default BOARD_X1000_HALLEY2_V10

config BOARD_X1000_HALLEY2_V10
bool "board x1000 halley2 v10"
depends on PRODUCT_X1000_HALLEY2

endchoice

config BOARD_NAME
string
default "halley2_v10" if BOARD_X1000_HALLEY2_V10
```

## arch/mips/xburst/soc-x1000/chip-x1000/phoenix/Kconfig
```kconfig
choice
prompt "BOARD version"
depends on PRODUCT_X1000_PHOENIX
default BOARD_X1000_PHOENIX_V20

config BOARD_X1000_PHOENIX_V20
bool "board x1000 phoenix v20"
depends on PRODUCT_X1000_PHOENIX

endchoice

config BOARD_NAME
string
default "phoenix_v20" if BOARD_X1000_PHOENIX_V20
```

## drivers/iio/imu/garnet/Kconfig
```kconfig
#
# inv-mpu-iio driver for Invensense MPU
#

config ICM30630_INV_MPU_IIO
	tristate "ICM30630 Invensense MPU devices"
	depends on I2C && SYSFS && SENSORHUB_ICM30630
	select IIO_BUFFER
	select IIO_TRIGGERED_BUFFER
	default n
	help
	  This driver supports the Invensense mpu devices.
	  This driver can be built as a module. The module will be called
	  inv-mpu-iio.

config ICM30630_INV_MPU_IIO_I2C
	tristate "ICM30630 Invensense MPU devices on I2C bus"
	depends on I2C && SYSFS && ICM30630_INV_MPU_IIO
	select IIO_BUFFER
	select IIO_TRIGGERED_BUFFER
	default n
	help
	  This driver supports the Invensense mpu devices.
	  This driver can be built as a module. The module will be called
	  inv-mpu-iio.

config ICM30630_INV_MPU_IIO_SPI
	tristate "ICM30630 Invensense MPU devices on SPI bus"
	depends on SPI && SYSFS && ICM30630_INV_MPU_IIO
	select IIO_BUFFER
	select IIO_TRIGGERED_BUFFER
	default n
	help
	  This driver supports the Invensense mpu devices.
	  This driver can be built as a module. The module will be called
	  inv-mpu-iio.
```

## drivers/input/touchscreen/focaltech/Kconfig
```kconfig
#
# Touchscreen driver focaltech configuration ( now just use for ft3x0x)
#

config TOUCHSCREEN_FOCALTECH
       tristate "Touchscreen focaltech (now just use ft3x0x)"
       depends on I2C && M200_SUPPORT_TSC
       default n
       help
       now just use ft3x0x for in901 board

if TOUCHSCREEN_FOCALTECH
config FOCALTECH_GESTRUE
	 bool "focaltech click wakeup system"
	 depends on TOUCHSCREEN_FOCALTECH
	 default n
	 help
		just distinguish click action so do not use gestrue lib

config FOCALTECH_EXT_FUNC
	 bool "focaltech extra function"
	 depends on TOUCHSCREEN_FOCALTECH
	 default n
	 help
		the focaltech type IC (now just for FT3X0X) extra function:
		l.sysfs inferface
		2.tp firmware upgrade control
		3.tp regs read write

if FOCALTECH_EXT_FUNC

config FOCALTECH_AUTO_UPGRADE
	 bool "focaltech auto upgrade"
	 depends on FOCALTECH_EXT_FUNC
	 default n
	 help
	 the focaltech type IC (now just for FT3X0X) auto upgrade as your version large than the older.

config FOCALTECH_SYSFS_DEBUG
	 bool "focaltech debug by the sysfs"
	 depends on FOCALTECH_EXT_FUNC
	 default n
	 help
	 1. the focaltech type IC (now just for FT3X0X) debug by the sysfs interface.
	 2. the focaltech type IC (now just for FT3X0X) can echo the firmware name which the path should be right to the sysfs to update the firmware.
	 (the path of the firmware push is accordding to the function "fts_GetFirmwareSize" and "fts_ReadFirmware" which is in focaltech_ex_fun.c,default path is /sdcard/xxx)
	 eg. "echo xxx.bin > ftsfwupgradeapp", and xxx.bin should be exist in the /sdcard/

config FOCALTECH_FTS_CTL_IIC
	 bool "focaltech RW i2c driver and apk debug by select the follow choose"
	 depends on FOCALTECH_EXT_FUNC
	 default n
	 help
	 the focaltech type IC (now just for FT3X0X) read or write i2c driver.(may read the firmware from focaltech)

if FOCALTECH_FTS_CTL_IIC
config FOCALTECH_APK_DEBUG
	 bool "focaltech debug by the apk"
	 depends on FOCALTECH_FTS_CTL_IIC
	 default y
	 help
	 you can debug by install the apk
endif

endif
endif
```

## drivers/mfd/frizz/Kconfig
```kconfig
#
# "sensor hub devices"
#

menu "Mega Chips support"
    depends on INPUT

config SENSORHUB_MCC
    tristate "Mega chips support"
    depends on INPUT
    default n
    ---help---
      If unsure, say Y.

if SENSORHUB_MCC

config FRIZZ
	tristate "Frizz sensor hub support"
	default y
	depends on SENSORHUB_MCC
	help
	  If you select yes here that will support Mega Chips's
	  sensor hub frizz for your product.

endif #SENSORHUB_MCC

config FRIZZ_VERIFY
    tristate "firmware download verify"
	default n
	depends on FRIZZ
	help
	  If you select yes here, when burn frizz firmware, it will
	  verify, and it takes more time.
if FRIZZ

config WAKEUP_BY_RAISE
	tristate "this is just a test config, should no more been used, see help"
	default n
	help
		enable the Gesture to wakeup android, but the android(IWDS) has the choice and profile
		to do such thing.So just leave it for test.

endif

endmenu
```

## drivers/misc/efuse/Kconfig
```kconfig
menuconfig JZ_EFUSE
	bool "ingenic efuse support"
	default n
if JZ_EFUSE
config  JZ_EFUSE_V12
	tristate "jz efuse version 1.2 support"
	depends on SOC_M200
	default n
	help
	  Say 'Y' to enable jz efuse version 1.2 for m200 efuse

config JZ_EFUSE_WRITE
	bool "Jz efuse write interface support"
	default n
	help
	  Say 'Y' to enable efuse write interface, only enable in
	  slt test or debugging, in other instances,
	  strongly recommended to turn off this option.
endif
```

## drivers/mtd/nand/ingenic/Kconfig
```kconfig
config MTD_NAND_JZ
	tristate "Support for jz MTD NAND Flash  driver"
	help
		Enables support for NAND Flash on ingenic.

if MTD_NAND_JZ

config MTD_NAND_JZ_BUS_WITDH_16
	bool "Support for 16bit buswidth nand"
	default n

config MTD_NAND_JZBCH
	bool "Support for jz bch driver for mtd nand"
	default y

choice
	prompt "Nand init mode"
	help
	  Select Nand init Mode (Nand params config as automatic or traditional config)

config MTD_NAND_JZ_AUTO
	bool "Automatic config params"
	help
	  Say Y here to enable Automatic config params
	  (Automatic config params : use ingenic burner write the params on nand)

config MTD_NAND_JZ_NORMAL
	bool "traditional config params"
	help
	  Say Y here to enable traditional config params
	  (traditional config params : use kerenl nand_ids)
endchoice

choice
	prompt "Nand controller select"
	help
	   Select Nand controller
config MTD_NAND_JZNFI
	bool "Nand Flash Interface (NFI)"
config MTD_NAND_JZNEMC
	bool "External Nand Memory Controller (NEMC)"
endchoice

choice
	prompt "nand flash chip select for jz board"
	depends on MTD_NAND_JZ_NORMAL
config MTD_NAND_MIRCON_ACA
	bool	"MICRON MT29F32G08CBACA"
endchoice
endif #MTD_NAND_JZ
```

## drivers/video/jz_fb_v11/Kconfig
```kconfig
menuconfig FB_JZ_V11
	tristate "JZ LCDC  framebuffer V1.1"
	depends on FB && (SOC_4780 || SOC_4775)
	select FB_CFB_FILLRECT
	select FB_CFB_COPYAREA
	select FB_CFB_IMAGEBLIT
	help
	  Framebuffer support for the JZ4775 && JZ4780 SoC.

config DISABLE_LVDS_FUNCTION
       bool "disable LVDS function for JZSOC lcd controller"
       depends on FB_JZ_V11
       default n

config JZ_EPD_GPIO_FUNCTION
       bool "Enable EPD GPIO function for JZSOC EPD controller"
       depends on FB && (FB_JZ4775_ANDROID_EPD)
       default n

config JZ4780_AOSD
		bool "aosd function"
		depends on FB_JZ_V11
		default n
		help
		If you plan to use the graphics internal AOSD module to
		deal with video UI for frame buffer when video directly
		output to LCD controller foregrount 1, say Y here.

config JZFB_LCDC_INIT
		bool "Initialize the LCD controller"
		depends on FB_JZ_V11
		default n
		help
		If you want to initialize the LCD controller when
		register framebuffer driver, say Y here.
```

## drivers/video/jz_fb_v13/Kconfig
```kconfig
# JZ LCD V1.3  configuration

menuconfig FB_JZ_V13
	tristate "JZ LCDC framebuffer V1.3"
	depends on FB
	select FB_CFB_FILLRECT
	select FB_CFB_COPYAREA
	select FB_CFB_IMAGEBLIT
	help
	  Framebuffer support for the M200/T10 SoC.

choice
	depends on FB_JZ_V13
	prompt "set lcd gpio"
	default LCD_GPIO_FUNC0_24BIT

config LCD_V13_SLCD_8BIT
	bool "lcd v13  8bit slcd"
	help
	 set lcd gpio function1 only for 8bit smart panel
		for example,
		for truly_tft240240_2_e panel, set it
config LCD_V13_SLCD_9BIT
	bool "lcd v13 9bit slcd"
	help
	 set lcd gpio function1 only for 9bit smart panel
config LCD_V13_SLCD_16BIT
	bool "lcd v13 16bit slcd"
	help
	 set lcd gpio function1 only for 16bit smart panel
endchoice

config FB_JZ_DEBUG
        bool "fb test for displaying color bar"
        depends on FB_JZ_V13
        default n
        help
           fb test for displaying color bar in your board.
```

## drivers/video/jz_ipu/Kconfig
```kconfig
config JZ_IPU_V12
	bool "IPU V12 Driver"
	help
	  Support for Ingenic ipu v12 operations.
```

## drivers/video/jz_vfb/Kconfig
```kconfig
menuconfig VFB_JZ
	tristate "JZ virtual framebuffer(just for test)"
	depends on FB
	select FB_CFB_FILLRECT
	select FB_CFB_COPYAREA
	select FB_CFB_IMAGEBLIT
	help
	  virtual Framebuffer support
config VFB_XRES
        int "vfb xres"
        depends on VFB_JZ
        default 480
        help
          virtual fb size:pix number of each line
config VFB_YRES
        int "vfb yres"
        depends on VFB_JZ
        default 640
        help
          virtual fb size: number of lines
config VFB_BPP
        int "vfb bpp"
        depends on VFB_JZ
        default 24
        help
          virtual fb bpp info
```

## drivers/video/jz_vpu/Kconfig
```kconfig
#
# jz vpu configuration
#

menuconfig JZ_VPU
	bool"JZ VPU driver"
	default y
	help
		VPU support.

choice
	depends on JZ_VPU
	prompt "select vpu type"
	default JZ_VPU_V13

config JZ_VPU_PRE
	bool "VPU driver for Ingenic previous version"
	help
	  Support for Ingenic VPU muti-thread operations.

config JZ_VPU_V12
	bool "VPU driver v12 for Ingenic m200"
	help
	  Support for Ingenic VPU muti-thread operations.

config JZ_VPU_V13
	bool "VPU driver v13 for Ingenic x1000"
	help
	  Support for Ingenic VPU muti-thread operations.

endchoice
```

## security/smack/Kconfig
```kconfig
config SECURITY_SMACK
	bool "Simplified Mandatory Access Control Kernel Support"
	depends on NET
	depends on INET
	depends on SECURITY
	select NETLABEL
	select SECURITY_NETWORK
	default n
	help
	  This selects the Simplified Mandatory Access Control Kernel.
	  Smack is useful for sensitivity, integrity, and a variety
	  of other mandatory security schemes.
	  If you are unsure how to answer this question, answer N.

config SECURITY_SMACK_PERMISSIVE_MODE
	bool "Enable Permissive mode for debugging purpose"
	depends on SECURITY_SMACK
	help
	  This selects the permissive mode of smack for debug purpose. This
	  do not block any access of the smack policy and just warn the block
	  by log message.
```
